## configs/buildroot/rz-solidrun_defconfig
```kconfig
BR2_aarch64=y
BR2_cortex_a55=y
BR2_TOOLCHAIN_BUILDROOT_GLIBC=y
BR2_KERNEL_HEADERS_5_10=y
BR2_ROOTFS_DEVICE_CREATION_DYNAMIC_EUDEV=y
BR2_TARGET_GENERIC_ROOT_PASSWD="root"
BR2_ROOTFS_OVERLAY="../../overlay/buildroot"
BR2_TARGET_GENERIC_GETTY=y
BR2_TARGET_GENERIC_GETTY_PORT="ttySC0"
BR2_PACKAGE_BLUEZ_ALSA=y
BR2_PACKAGE_BLUEZ_ALSA_HCITOP=y
BR2_PACKAGE_STRESS=y
BR2_PACKAGE_GIT=y
BR2_PACKAGE_JQ=y
BR2_PACKAGE_CPIO=y
BR2_PACKAGE_MMC_UTILS=y
BR2_PACKAGE_FB_TEST_APP=y
BR2_PACKAGE_WESTON=y
BR2_PACKAGE_CPUBURN_ARM=y
BR2_PACKAGE_LSSCSI=y
BR2_PACKAGE_MEMTESTER=y
BR2_PACKAGE_OPENOCD=y
BR2_PACKAGE_PICOCOM=y
BR2_PACKAGE_RS485CONF=y
BR2_PACKAGE_RTC_TOOLS=y
BR2_PACKAGE_BC=y
BR2_PACKAGE_COLLECTD=y
BR2_PACKAGE_COLLECTD_CPU=y
BR2_PACKAGE_COLLECTD_CPUFREQ=y
BR2_PACKAGE_COLLECTD_CURL=y
BR2_PACKAGE_COLLECTD_PING=y
BR2_PACKAGE_COLLECTD_SENSORS=y
BR2_PACKAGE_COLLECTD_THERMAL=y
BR2_PACKAGE_EMPTY=y
BR2_PACKAGE_BLUEZ_TOOLS=y
BR2_PACKAGE_BLUEZ5_UTILS_CLIENT=y
BR2_PACKAGE_BLUEZ5_UTILS_MONITOR=y
BR2_PACKAGE_BLUEZ5_UTILS_DEPRECATED=y
BR2_PACKAGE_BLUEZ5_UTILS_EXPERIMENTAL=y
BR2_PACKAGE_BLUEZ5_UTILS_PLUGINS_HEALTH=y
BR2_PACKAGE_BLUEZ5_UTILS_PLUGINS_MESH=y
BR2_PACKAGE_BLUEZ5_UTILS_PLUGINS_MIDI=y
BR2_PACKAGE_BLUEZ5_UTILS_PLUGINS_NFC=y
BR2_PACKAGE_BLUEZ5_UTILS_PLUGINS_SAP=y
BR2_PACKAGE_BLUEZ5_UTILS_PLUGINS_SIXAXIS=y
BR2_PACKAGE_BLUEZ5_UTILS_TEST=y
BR2_PACKAGE_BLUEZ5_UTILS_TOOLS_HID2HCI=y
BR2_PACKAGE_CAN_UTILS=y
BR2_PACKAGE_CONNMAN=y
BR2_PACKAGE_CONNMAN_WIFI=y
BR2_PACKAGE_CONNMAN_BLUETOOTH=y
BR2_PACKAGE_DEHYDRATED=y
BR2_PACKAGE_DHCP=y
BR2_PACKAGE_DHCP_CLIENT=y
BR2_PACKAGE_DHCPCD=y
BR2_PACKAGE_DHCPDUMP=y
BR2_PACKAGE_ETHTOOL=y
BR2_PACKAGE_HOSTAPD=y
BR2_PACKAGE_IFUPDOWN=y
BR2_PACKAGE_IPERF3=y
BR2_PACKAGE_IPROUTE2=y
BR2_PACKAGE_IPSET=y
BR2_PACKAGE_IPUTILS=y
BR2_PACKAGE_IW=y
BR2_PACKAGE_NET_TOOLS=y
BR2_PACKAGE_NETSTAT_NAT=y
BR2_PACKAGE_NTP=y
BR2_PACKAGE_OPENSSH=y
BR2_PACKAGE_TCPDUMP=y
BR2_PACKAGE_WIRELESS_TOOLS=y
BR2_PACKAGE_WPA_SUPPLICANT_AP_SUPPORT=y
BR2_PACKAGE_WPA_SUPPLICANT_AUTOSCAN=y
BR2_PACKAGE_WPA_SUPPLICANT_PASSPHRASE=y
BR2_PACKAGE_HTOP=y
BR2_TARGET_ROOTFS_CPIO=y
BR2_TARGET_ROOTFS_CPIO_GZIP=y
BR2_TARGET_ROOTFS_EXT2=y
BR2_TARGET_ROOTFS_EXT2_4=y
BR2_TARGET_ROOTFS_EXT2_SIZE="150M"
BR2_PACKAGE_UTIL_LINUX_RFKILL=y
```

## configs/buildroot/rzg2lc-solidrun_defconfig
```kconfig
BR2_aarch64=y
BR2_cortex_a55=y
BR2_TOOLCHAIN_BUILDROOT_GLIBC=y
BR2_KERNEL_HEADERS_5_10=y
BR2_ROOTFS_DEVICE_CREATION_DYNAMIC_EUDEV=y
BR2_TARGET_GENERIC_ROOT_PASSWD="root"
BR2_ROOTFS_OVERLAY="../../overlay/buildroot"
BR2_PACKAGE_STRESS=y
BR2_PACKAGE_GIT=y
BR2_PACKAGE_JQ=y
BR2_PACKAGE_CPIO=y
BR2_PACKAGE_MMC_UTILS=y
BR2_PACKAGE_FB_TEST_APP=y
BR2_PACKAGE_WESTON=y
BR2_PACKAGE_LSSCSI=y
BR2_PACKAGE_MEMTESTER=y
BR2_PACKAGE_OPENOCD=y
BR2_PACKAGE_PICOCOM=y
BR2_PACKAGE_RS485CONF=y
BR2_PACKAGE_RTC_TOOLS=y
BR2_PACKAGE_BC=y
BR2_PACKAGE_COLLECTD=y
BR2_PACKAGE_COLLECTD_CPU=y
BR2_PACKAGE_COLLECTD_CPUFREQ=y
BR2_PACKAGE_COLLECTD_CURL=y
BR2_PACKAGE_COLLECTD_PING=y
BR2_PACKAGE_COLLECTD_SENSORS=y
BR2_PACKAGE_COLLECTD_THERMAL=y
BR2_PACKAGE_EMPTY=y
BR2_PACKAGE_BLUEZ_TOOLS=y
BR2_PACKAGE_BLUEZ5_UTILS=y
BR2_PACKAGE_BLUEZ5_UTILS_CLIENT=y
BR2_PACKAGE_BLUEZ5_UTILS_TOOLS_HID2HCI=y
BR2_PACKAGE_CAN_UTILS=y
BR2_PACKAGE_DEHYDRATED=y
BR2_PACKAGE_DHCP=y
BR2_PACKAGE_DHCP_CLIENT=y
BR2_PACKAGE_DHCPCD=y
BR2_PACKAGE_DHCPDUMP=y
BR2_PACKAGE_ETHTOOL=y
BR2_PACKAGE_HOSTAPD=y
BR2_PACKAGE_IPERF3=y
BR2_PACKAGE_IW=y
BR2_PACKAGE_WPA_SUPPLICANT=y
BR2_PACKAGE_WPA_SUPPLICANT_PASSPHRASE=y
BR2_PACKAGE_KMOD=y
BR2_PACKAGE_NETSTAT_NAT=y
BR2_PACKAGE_OPENSSH=y
BR2_PACKAGE_HTOP=y
BR2_PACKAGE_LIBGPIOD=y
BR2_PACKAGE_LIBGPIOD_TOOLS=y
BR2_PACKAGE_SPIDEV_TEST=y
BR2_TARGET_ROOTFS_CPIO=y
BR2_TARGET_ROOTFS_CPIO_GZIP=y
BR2_TARGET_ROOTFS_EXT2=y
BR2_TARGET_ROOTFS_EXT2_4=y
BR2_TARGET_ROOTFS_EXT2_SIZE="150M"
```

## configs/image/overlays-fit.its
```
/dts-v1/;

/ {
    description = "Device Tree Overlays Image";
    #address-cells = <1>;

    images {
        sd_overlay {
            description = "SD Card Overlay";
            data = /incbin/("sd-overlay.dtbo");
            type = "flat_dt";
            arch = "arm";
            compression = "none";
        };

        mmc_overlay {
            description = "MMC Overlay";
            data = /incbin/("mmc-overlay.dtbo");
            type = "flat_dt";
            arch = "arm";
            compression = "none";
        };
    };
};
```
